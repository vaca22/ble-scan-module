
#include <stdio.h>
#include <string.h>
#include "driver/gpio.h"
#include "driver/i2c.h"
#include "oled1306.h"

#define I2C_SCL_IO      GPIO_NUM_22
#define I2C_SDA_IO      GPIO_NUM_23 
#define I2C_NUM         0
#define I2C_FREQ_HZ     400000
#define I2C_TIMEOUT_MS  1000
#define DEV_ADDR        (0x78 >> 1)

#define I2C_SOFT        1

#define i2c_scl_0() gpio_set_level(I2C_SCL_IO, 0)
#define i2c_scl_1() gpio_set_level(I2C_SCL_IO, 1)
#define i2c_sda_0() gpio_set_level(I2C_SDA_IO, 0)
#define i2c_sda_1() gpio_set_level(I2C_SDA_IO, 1)


const uint8_t oled_init_cmd[25] = 
{
  /*0xae,0X00,0X10,0x40,0X81,0XCF,0xff,0xa1,0xa4,
  0xA6,0xc8,0xa8,0x3F,0xd5,0x80,0xd3,0x00,0XDA,0X12,
  0x8d,0x14,0xdb,0x40,0X20,0X02,0xd9,0xf1,0xAF*/
       0xAE,//关闭显示
       0xD5,//设置时钟分频因子,震荡频率
       0x80,  //[3:0],分频因子;[7:4],震荡频率
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       0xAF,//开启显示     
};

#if I2C_SOFT == 1
void delay_us(int32_t us)
{
  unsigned char x=0;
  for(;us>0;us--)
  {
    x++;x++;x++;x++;x++;x++;x++;x++;x++;x++;x++;x++;
	  x++;x++;x++;x++;x++;x++;x++;x++;x++;x++;x++;x++;
	  x++;x++;x++;x++;x++;x++;x++;x++;x++;x++;x++;x++;
  }
}

void i2c_init(void)
{
    gpio_config_t pin_cfg;
    pin_cfg.pin_bit_mask = (1Ull << I2C_SCL_IO) | (1 << I2C_SDA_IO);
    pin_cfg.mode = GPIO_MODE_OUTPUT;
    pin_cfg.pull_up_en = GPIO_PULLUP_ENABLE;
    pin_cfg.pull_down_en = GPIO_PULLDOWN_DISABLE;
    pin_cfg.intr_type = GPIO_INTR_DISABLE;
    gpio_config(&pin_cfg);
}

void i2c_write(uint8_t data)
{
	uint8_t i, temp;
	temp = data;
			
	for(i=0; i<8; i++)
	{	i2c_scl_0();
		
        if ((temp&0x80)==0)
            i2c_sda_0();
        else i2c_sda_1();
		temp = temp << 1;
		delay_us(1);			  
        i2c_scl_1();
		delay_us(1);
		
	}
	i2c_scl_0();
	delay_us(1);
    i2c_sda_1();
	delay_us(1);
    i2c_scl_1();
	delay_us(1);
	i2c_scl_0();
	delay_us(1);
	

}

void i2c_start(void)
{
    i2c_sda_1();
    delay_us(1);
    i2c_scl_1();
    delay_us(1);
    i2c_sda_0();
    delay_us(3);
    i2c_scl_0();
    i2c_write(0x78);
}

void i2c_stop(void)
{
    i2c_sda_0();
    delay_us(1);
    i2c_scl_1();
    delay_us(3);
    i2c_sda_1();
}

void oled_send_cmd(uint8_t cmd)
{
    i2c_start();
    i2c_write(0x00);
    i2c_write(cmd);
    i2c_stop();
}

void oled_send_data(uint8_t *data, int32_t size)
{
    int32_t i;
    i2c_start();
    i2c_write(0x40);
    for(i = 0; i < size; i++)
    {
        i2c_write(*data++);
    }
    i2c_stop();
}

#else

#if 1
esp_err_t i2c_master_write_to_device_append(i2c_port_t i2c_num, uint8_t device_address,
                                     uint8_t append, const uint8_t* write_buffer, 
                                     size_t write_size, TickType_t ticks_to_wait)
{
    esp_err_t err = ESP_OK;
    uint8_t buffer[180];
    i2c_cmd_handle_t handle = i2c_cmd_link_create_static(buffer, sizeof(buffer));
    assert (handle != NULL);
    err = i2c_master_start(handle);
    if (err != ESP_OK) {
        goto end;
    }
    err = i2c_master_write_byte(handle, device_address << 1 | I2C_MASTER_WRITE, true);
    if (err != ESP_OK) {
        goto end;
    }
    err = i2c_master_write_byte(handle, append, true);
    if (err != ESP_OK) {
        goto end;
    }
    err = i2c_master_write(handle, write_buffer, write_size, true);
    if (err != ESP_OK) {
        goto end;
    }
    i2c_master_stop(handle);
    err = i2c_master_cmd_begin(i2c_num, handle, ticks_to_wait);
end:
    i2c_cmd_link_delete_static(handle);
    return err;
}
#endif

void i2c_init(void)
{
    int32_t i2c_port = I2C_NUM;
    i2c_config_t conf = 
    {
        .mode = I2C_MODE_MASTER,
        .sda_io_num = I2C_SDA_IO,
        .scl_io_num = I2C_SCL_IO,
        .sda_pullup_en = GPIO_PULLUP_ENABLE,
        .scl_pullup_en = GPIO_PULLUP_ENABLE,
        .master.clk_speed = I2C_FREQ_HZ,
    };
    i2c_param_config(i2c_port, &conf);
    i2c_driver_install(i2c_port, conf.mode, 0, 0, 0);
}

#define DEV_REG_CMD     0x00
#define DEV_REG_DATA    0x40
void oled_send_cmd(uint8_t cmd)
{
    uint8_t buf[2];
    buf[0] = DEV_REG_CMD;
    buf[1] = cmd;
    i2c_master_write_to_device(I2C_NUM, DEV_ADDR, buf, 2, 1);
}

void oled_send_data(uint8_t *data, int32_t size)
{
    i2c_master_write_to_device_append(I2C_NUM, DEV_ADDR, DEV_REG_DATA, data, size, 4);
}

#endif

void column_set(uint8_t column)
{
    oled_send_cmd(0x10 | (column >> 4));
    oled_send_cmd(0x00 | (column & 0x0f));
}

void page_set(uint8_t page)
{
    oled_send_cmd(0xb0 + page);
}

void oled_clear(uint8_t data)
{
    uint32_t page;
    uint8_t buf[128];
    memset(buf, data, 128);
    for(page = 0; page < 8; page++)
    {
        page_set(page);
        column_set(0);
        oled_send_data(buf, 128);
    }
}

void oled1306_cmd_init(void)
{
    int32_t i;
    for(i = 0; i < 25; i++)
    {
        oled_send_cmd(oled_init_cmd[i]);
    }
}

static int32_t init_flag = 0;
void oled1306_init(void)
{
    if(init_flag)
    {
        printf("[1306]init already done\n");
        return;
    }
    printf("[1306]init\n");
    i2c_init();
    oled1306_cmd_init();
    init_flag = 1;
}

void oled1306_flush(uint8_t *data)
{
    uint8_t page;
    for(page=0; page<(64/8); page++)
    { 
        page_set(page);
        column_set(0);	  
        oled_send_data(data, 128);
        data += 128;
    }
}

void oled1306_fill_with(uint8_t data)
{
    oled_clear(data);
}

#include "plat_os.h"

void oled1306_test(void)
{
    int32_t data = 0x0f;
    oled1306_init();
    while(1)
    {
        oled_clear(data);
        os_thread_sleep(500);
        data++;
    }
}


const unsigned char  picture_tab[]={
/*------------------------------------------------------------------------------
;  源文件 / 文字 : C:\Documents and Settings\Administrator\桌面\新建文件夹 (2)\logo.bmp字模
;  宽×高（像素）: 128×64
------------------------------------------------------------------------------*/
//0x80,0x40,0x10,//宽的像素数,高的像素数，宽的字节数，参数设置可选
0xFF,0x01,0x01,0x01,0x01,0x01,0x01,0x01,0x01,0x01,0x01,0x01,0x01,0x01,0x01,0x01,
0x01,0x01,0x01,0x01,0x01,0x01,0x01,0x01,0x01,0x01,0x01,0x01,0x01,0x01,0x01,0x01,
0x01,0x01,0x01,0x01,0x01,0x01,0x01,0x01,0x01,0x01,0x01,0x01,0x01,0x01,0x01,0x01,
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0x80,0x80,0x80,0x80,0x80,0x80,0x80,0x80,0x80,0x80,0x80,0x80,0x80,0x80,0x80,0xFF
};

